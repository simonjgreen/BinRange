## firmware/k4w-tag/boards/kkm/k4w/board.yml
```yaml
board:
  name: k4w
  full_name: KKM K4W test tag
  vendor: others
  socs:
    - name: nrf52833
```

## firmware/nesso-probe/sdkconfig.defaults
```kconfig
CONFIG_IDF_TARGET="esp32c6"
CONFIG_ESPTOOLPY_FLASHSIZE_16MB=y
CONFIG_ESPTOOLPY_FLASHSIZE="16MB"
CONFIG_ESPTOOLPY_FLASHMODE_DIO=y
CONFIG_ESP_CONSOLE_USB_SERIAL_JTAG=y
CONFIG_ESP_DAP_SERIAL_CONSOLE_ENABLED=y
# CONFIG_ESP_DAP_SOCKET_CONSOLE_ENABLED is not set
CONFIG_ESP_DAP_1_TCP_PORT=4441
CONFIG_ESP_DAP_1_SWD_SUPPORTED=y
# CONFIG_ESP_DAP_1_JTAG_SUPPORTED is not set
# CONFIG_ESP_DAP_1_JTAG_NTRST_SUPPORTED is not set
# CONFIG_ESP_DAP_1_NRESET_SUPPORTED is not set
CONFIG_ESP_DAP_1_GPIO_SWCLK_TCK=6
CONFIG_ESP_DAP_1_GPIO_SWDIO_TMS=7
CONFIG_ESP_DAP_1_LED_NONE=y
# CONFIG_ESP_DAP_1_LED_STANDARD is not set
# CONFIG_ESP_DAP_1_LED_RGB is not set
# CONFIG_ESP_DAP_2_ENABLED is not set
# CONFIG_ESP_DAP_3_ENABLED is not set
# CONFIG_ESP_UART_BRIDGE_1_ENABLED is not set
# CONFIG_ESP_UART_BRIDGE_2_ENABLED is not set
# CONFIG_ESP_UART_BRIDGE_3_ENABLED is not set
# CONFIG_ESP_ADC_STREAM_ENABLED is not set
CONFIG_ESP_DAP_MANAGE_WIFI=y
CONFIG_ESP_WIFI_SSID=""
CONFIG_ESP_WIFI_PASSWORD=""
CONFIG_ESP_MAXIMUM_RETRY=20
CONFIG_ESP_DAP_PRODUCT_ID="BinRange Nesso SWD"
CONFIG_ESP_DAP_IO_PORT_WRITE_CYCLES=63
CONFIG_ESP_DAP_DELAY_SLOW_CYCLES=5
CONFIG_ESP_DAP_1_DRIVE_STRENGTH_0=y
CONFIG_COMPILER_OPTIMIZATION_PERF=y
```
